## boards/shields/charybdis_common/Kconfig.dongle.defconfig
```kconfig
if SHIELD_CHARYBDIS_DONGLE

config ZMK_KEYBOARD_NAME
	default "Charybdis"

config ZMK_SPLIT_ROLE_CENTRAL
	default y

endif

if SHIELD_CHARYBDIS_DONGLE_LEFT

config ZMK_KEYBOARD_NAME
	default "charybdis_left"

endif

if SHIELD_CHARYBDIS_DONGLE_RIGHT

config ZMK_KEYBOARD_NAME
	default "charybdis_right"

endif

if SHIELD_CHARYBDIS_DONGLE_LEFT || SHIELD_CHARYBDIS_DONGLE_RIGHT || SHIELD_CHARYBDIS_DONGLE

config ZMK_SPLIT
	default y

endif
```
