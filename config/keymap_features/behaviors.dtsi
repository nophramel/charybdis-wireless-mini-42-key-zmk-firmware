#define KEYS_L 0 1 2 3 4 5 12 13 14 15 16 17 24 25 26 27 28 29 36 37 38  // Left-hand keys.
#define KEYS_R 6 7 8 9 10 11 18 19 20 21 22 23 30 31 32 33 34 35 39 40   // Right-hand keys.
#define THUMBS 36 37 38 39 40 41                                         // Thumb keys.

/ {
    behaviors {
        hmr: hmr {
            compatible = "zmk,behavior-hold-tap";
            label = "HMR";
            bindings = <&kp>, <&kp>;

            #binding-cells = <2>;
            tapping-term-ms = <190>;
            quick-tap-ms = <175>;
            flavor = "balanced";
            hold-trigger-key-positions = <0 1 2 3 4 5 12 13 14 15 16 17 24 25 26 27 28 29 36 37 38 39 40 41>;
            hold-trigger-on-release;
        };

        hml: hml {
            compatible = "zmk,behavior-hold-tap";
            label = "HML";
            bindings = <&kp>, <&kp>;

            #binding-cells = <2>;
            tapping-term-ms = <190>;
            quick-tap-ms = <175>;
            flavor = "balanced";
            hold-trigger-key-positions = <6 7 8 9 10 11 18 19 20 21 22 23 30 31 32 33 34 35 39 40 41 36 37 38>;
            hold-trigger-on-release;
        };
    }
};
